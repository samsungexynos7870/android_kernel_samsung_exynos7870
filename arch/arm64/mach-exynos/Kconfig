## arch/arm64/mach-exynos/Kconfig
```kconfig
# arch/arm64/mach-exynos/Kconfig
#
# Copyright (c) 2016 Samsung Electronics Co., Ltd.
#		http://www.samsung.com/
#
# Licensed under GPLv2

# Configuration options for the EXYNOS8

if ARCH_EXYNOS

menu "SAMSUNG EXYNOS SoCs Support"

config SKIP_HW_BREAKPOINT
	bool "support skip hw breakpoint"
	default n
	help
	  Support early param for T32 onchip breakpoint

menuconfig EXYNOS_DTBTOOL
	bool "Build dtbtool for Exynos"
	select DTC
	default n
	help
	  Say Y here to build the dtbtool for Exynos,
	  which is necessary to create DTB images for
	  use in Exynos boot images.

if EXYNOS_DTBTOOL

config EXYNOS_DTBH_PLATFORM_CODE
	hex "Exynos DTBH hex platform code"
	default 0x50a6
	help
	  This value is verified by the bootloader
	  to determine if the DTB image is valid for
	  the device that the kernel is booting on.

config EXYNOS_DTBH_SUBTYPE_CODE
	hex "Exynos DTBH hex subtype code"
	default 0x217584da
	help
	  This value is verified by the bootloader
	  to determine if the DTB image is valid for
	  the device that the kernel is booting on.

config EXYNOS_DTBH_PAGE_SIZE
	int "Exynos DTBH page size"
	range 2048 131072
	default 2048
	help
	  Page size used to pad the DTB image.
	  It should be equal to the page size of
	  the Exynos boot image.
	  Must be divisible by 2048.

endif

endmenu

endif
```

## drivers/ccic/Kconfig
```kconfig
#
# USB PD driver
#

comment "USB PD configs"

config USE_CCIC
	bool "Using USBPD device driver"
	depends on I2C
	default n
	help
	  If you say yes here you will get support for
	  the USB PD(Power Delivery) device driver.

config CCIC_S2MU004
	bool "Using S2MU004 USB PD"
	depends on USE_CCIC
	default n
	help
	  If you say yes here you will get support for
	  for the S2MU004 USBPD chip.

config CCIC_NOTIFIER
	bool "CCIC notifier support"
	depends on I2C
	default n
	help
	  If you say yes here you will get support for
	  the CCIC attached device status change notification.
```

## drivers/gps/Kconfig
```kconfig
config GPS_BCM4752
	bool "BROADCOM_GPS_CHIPSET_4752"
	default n

config GPS_LSI_S5N6420
	bool "LSI_GPS_CHIPSET_HARRIER"
	default n
```

## drivers/gpu/arm/t83x/Kconfig
```kconfig
#
# (C) COPYRIGHT 2012-2013 ARM Limited. All rights reserved.
#
# This program is free software and is provided to you under the terms of the
# GNU General Public License version 2 as published by the Free Software
# Foundation, and any use by you of this program is subject to the terms
# of such GNU licence.
#
# A copy of the licence is included with the program, and can also be obtained
# from Free Software Foundation, Inc., 51 Franklin Street, Fifth Floor,
# Boston, MA  02110-1301, USA.
#
#


menuconfig MALI_T83X
	tristate "Mali-T83X GPU support"
	help
	  Enable this option to build support for the ARM Mali-T83X GPU.
	  To compile this driver as a module, choose M here:
	  this will generate a single module, called mali_kbase.

choice
	prompt "Version configuration"
	depends on MALI_T83X
	default MALI_R22P0
	help
	  Select the gpu support version.

config MALI_R12P0
	depends on MALI_T83X
	bool "r12p0 driver"

config MALI_R15P0
	depends on MALI_T83X
	bool "r15p0 driver"

config MALI_R21P0
	depends on MALI_T83X
	bool "r21p0 driver"

config MALI_R22P0
	depends on MALI_T83X
	bool "r22p0 driver"

config MALI_R28P0
	depends on MALI_T83X
	bool "r28p0 driver"

config MALI_R29P0
	depends on MALI_T83X
	bool "r29p0 driver"
endchoice

if MALI_R12P0
source "drivers/gpu/arm/t83x/r12p0/Kconfig"
endif

if MALI_R15P0
source "drivers/gpu/arm/t83x/r15p0/Kconfig"
endif

if MALI_R21P0
source "drivers/gpu/arm/t83x/r21p0/Kconfig"
endif

if MALI_R22P0
source "drivers/gpu/arm/t83x/r22p0/Kconfig"
endif

if MALI_R28P0
source "drivers/gpu/arm/t83x/r28p0/Kconfig"
endif

if MALI_R29P0
source "drivers/gpu/arm/t83x/r29p0/Kconfig"
endif
```

## drivers/staging/samsung/Kconfig
```kconfig
# drivers/staging/samsung/Kconfig
#
# Copyright (c) 2010-2011 Samsung Electronics Co., Ltd.
#		http://www.samsung.com/
#
# Licensed under GPLv2

comment "Samsung TN Features"
menuconfig SEC_EXT
	bool "Samsung TN extension features"
	default y

config SEC_SYSFS
	bool "Create a sysfs node for SEC_CLASS"
	depends on SEC_EXT
	default y

config SEC_REBOOT
	bool "Enable TN reboot features"
	depends on SEC_EXT
	default y

menuconfig SEC_DEBUG
	bool "Enable TN debugging features"
	depends on EXYNOS_SNAPSHOT && SEC_REBOOT
	default y

config SEC_HW_REV
	bool "Get GPIO HW REV"
	depends on SEC_DEBUG
	default n

config SEC_DEBUG_LAST_KMSG
	bool "Write last_kmsg at /proc/last_kmsg"
	depends on SEC_DEBUG
	default y

config SEC_DEBUG_USER_RESET
	bool "USER RESET debug feature"
	depends on SEC_DEBUG
	default y
	help
	  This option enables debugging log for User Reset.
	  This option provides reset history log in user version.
	  This option enable proc/reset_reason support

config SEC_DEBUG_MDM_SEPERATE_CRASH
	bool "Enable modem crash with a seperated command"
	depends on SEC_DEBUG
	default n
	help
	  This option enables modem crash other debug level.

config SEC_DEBUG_FILE_LEAK
	bool "Panic when file leak detected"
	depends on SEC_DEBUG
	default n

comment "Samsung TN BSP Options"
config SEC_PARAM
	bool "Enable Param modification"
	depends on SEC_DEBUG
	default n
	help
	  Samsung TN Param Feature.

config SEC_BOOTSTAT
	bool "Enable TN Bootstat logging"
	depends on SEC_EXT
	default y

config SEC_INITCALL_DEBUG
	bool "Enable TN Initcall logging"
	depends on SEC_EXT
	default y

config ARGOS
	bool "Throughput monitoring Feature"
	default n
	help
	  Check throughput and set appropriate system parameters(CPU freq, affinity, etc)

comment "Samsung TN Logging Options"
config SEC_AVC_LOG
	default n
	bool "Enable avc audit log support" if EMBEDDED
	depends on SEC_EXT
	help
	  This option enables additional log buffer for audit log.

config SEC_DEBUG_TSP_LOG
	default n
	bool "Enable tsp log support" if EMBEDDED
	depends on SEC_EXT
	help
	  This option enables additional log buffer for tsp log.

config SEC_DEBUG_PMIC
	default n
	bool "Enable pmic debug option support" if EMBEDDED
	depends on SEC_EXT
	help
	  This option enables additional debug option for pmic.
	  Enable this option for eng build only.

comment "Samsung TN Power Management Options"
menuconfig SEC_PM
	bool "Samsung TN Power Management"
	default y
	help
	  Samsung TN Power Management.

config SEC_PM_DEBUG
	bool "Enable Samsung TN Power management debug support"
	default y
	depends on SEC_PM
	help
	  Enable Samsung TN Power management debug support.

config SEC_EVENT_LOG
	bool "Enable Event log parser"
	depends on SEC_EXT
	default y

comment "Samsung TN NAD Options"
config SEC_NAD
	bool "Samsung TN NAD Feature"
	default n
	help

	  Samsung TN NAD Feature, support AT CMD for NAD 2.0
	  	  
config SEC_NAD_MANUAL_PARAM_READTIME
	int "Samsung TN NAD Feature"
	depends on SEC_NAD
	default "10"
	help
	  Samsung TN NAD Feature, set param reading time manually.
```

## drivers/usb/typec/Kconfig
```kconfig
menu "USB Power Delivery and Type-C drivers"

config TYPEC
	tristate
	default y
	depends on CCIC_NOTIFIER

endmenu
```
