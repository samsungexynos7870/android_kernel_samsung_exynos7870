## arch/arm64/configs/a2corelte_defconfig
```kconfig
CONFIG_SECURITY_SELINUX=n
CONFIG_SECURITY_SELINUX_BOOTPARAM=n
CONFIG_SECURITY_SELINUX_DEVELOP=n
```

## drivers/input/touchscreen/imagis_30xxh/Kconfig
```kconfig
#
# Imagis IST30XXC Touchscreen driver
#

config TOUCHSCREEN_IST30XXC
  tristate "IST30XXC I2C Touchscreen"
	depends on I2C
	help
	  Say Y here if you have the Imagis IST30XXC I2C touchscreen
	  connected to your system.

config TOUCHSCREEN_IST3038H
  tristate "IST3038H I2C Touchscreen"
	depends on I2C
	help
	  Say Y here if you have the Imagis IST3038H I2C touchscreen
	  connected to your system.

config TOUCHSCREEN_IMAGIS_LPM_NO_RESET
  tristate "TOUCHSCREEN IMAGIS LPM NO RESET"
	depends on I2C
	help
	  Say Y here if you use
	  LPM No Reset Sequence.

config TOUCHSCREEN_IMAGIS_DT2W_AP
	bool "Imagis double tap to wake detected on the AP"
	depends on TOUCHSCREEN_IST3038H
	default n
	help
	  Detect double tap to wake in the driver instead of relying on
	  the touch controller firmware's low power gesture mode.

	  The IST3038H firmware on some panels accepts the whole LPM
	  gesture arm sequence and then never enables touch detection, so
	  no wake event is ever produced. Say Y here to keep the
	  controller in its normal scanning mode while the screen is off
	  and time the finger events on the AP instead.

	  This costs standby power, because the controller keeps scanning
	  at its active rate with the display off. Say N if you do not
	  need double tap to wake.
```
